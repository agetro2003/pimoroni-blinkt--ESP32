## main/Kconfig.projbuild
```kconfig
menu "Example Configuration"

    orsource "$IDF_PATH/examples/common_components/env_caps/$IDF_TARGET/Kconfig.env_caps"

    config  GPIO_CLOCK
        int "GPIO pin for SPI Clock signal"
        range ENV_GPIO_RANGE_MIN ENV_GPIO_OUT_RANGE_MAX
        default 18
        help 
            GPIO pin for SPI Clock signal. This pin is used to synchronize the data transmission between the master and slave devices.

    config GPIO_MOSI
        int "GPIO pin for SPI MOSI signal"
        range ENV_GPIO_RANGE_MIN ENV_GPIO_OUT_RANGE_MAX
        default 23
        help 
            GPIO pin for SPI MOSI signal. This pin is used to send data from the master device to the slave device.
    config DEFAULT_BRIGHTNESS
        int "Default brightness level"
        range 0 31
        default 7
        help 
            Default brightness level for the LED. This value can be adjusted to set the initial brightness of the LED when the program starts.

    config BROKER_URL
        string "Broker URL"
        default "mqtt://mqtt.eclipseprojects.io"
        help
            URL of the broker to connect to
        
endmenu
```
